## conf/distro/machine/am335x-evm.conf
```bitbake
#
# Quince Distribution - Configuration for BeagleBone Black/Green
#

# References
#
# * Yocto Project Reference Manual  12 Variables Glossary
#     https://docs.yoctoproject.org/5.0.8/ref-manual/variables.html

# Defines a serial console to enable using getty
SERIAL_CONSOLES = "115200;ttyS0"

# Holds the value of the console parameter of the kernel command line
KERNEL_CONSOLE = "ttyS0"

# The number of bits in the address space
QUINCE_BITS_OF_ADDRESS_SPACE = "32"

# PHRAM address (only valid if QUINCE_PHRAM is 1)
QUINCE_PHRAM_ADDR = "0x8C000000"

# PHRAM size (only valid if QUINCE_PHRAM is 1)
QUINCE_PHRAM_SIZE = "0x10000000"

KERNEL_MODULES = " \
"
```

## conf/layer.conf
```bitbake
# We have a conf and classes directory, append to BBPATH
BBPATH .= ":${LAYERDIR}"

# We have a recipes directory containing .bb and .bbappend files, add to BBFILES
BBFILES += "${LAYERDIR}/recipes*/*/*.bb \
            ${LAYERDIR}/recipes*/*/*.bbappend"

BBFILE_COLLECTIONS += "quince-ti"
BBFILE_PATTERN_quince-ti = "^${LAYERDIR}/"
BBFILE_PRIORITY_quince-ti = "15"

LAYERDEPENDS_quince-ti = "core"
LAYERSERIES_COMPAT_quince-ti = "scarthgap"
```
